## config/west.yml
```yaml
manifest:
  remotes:
    - name: zmkfirmware
      url-base: https://github.com/zmkfirmware
  projects:
    - name: zmk
      remote: zmkfirmware
      revision: 6cb42a80607c8bf8a493ac2c781568462aa8ce13
      import: app/west.yml
  self:
    path: zmk-config
```
